## main/Kconfig.projbuild
```kconfig
menu "Hackulator"

    config HACKU_OLED_SH1106
        bool "SH1106 panel (column-offset quirk)"
        default n
        help
            Enable when the 0.96" module uses an SH1106 controller
            instead of SSD1306. SH1106 GDDRAM is 132 columns wide,
            so the 128-wide image is shifted by 2 columns.
            Default (n) targets SSD1306, the common 4-pin module.

endmenu
```
